## Kconfig
```kconfig
#
# Copyright (c) 2026, Realtek Semiconductor Corporation
#
# SPDX-License-Identifier: Apache-2.0
#
config REALTEK_DISPLAY_ENABLE_JPU
    bool "Enable JPU (CodaJ12 JPEG codec)"
    default n
    help
        Driver for the CodaJ12 JPEG codec IP.

        The OS is not selected here: inc/rtl_jpu_port.h branches on JPU_OS_*,
        which SConscript and CMake each state for their own target.

        This is the driver's only build-time option.
```

## device/zephyr/dts/bindings/chipsemi,chsc6417.yaml
```yaml
#Copyright(c) 2025, Realtek Semiconductor Corporation.
#SPDX-License-Identifier: Apache-2.0

description: 
    Bindings for CHSC6417 touchscreen sensor

compatible: "chipsemi,chsc6417"

include: i2c-device.yaml

properties:
  irq-gpios:
    type: phandle-array
    required: true
    description: |
      Interrupt GPIO. Used by the controller to signal touch data is
      available. Active low.

  rst-gpios: 
    type: phandle-array
    required: true
    description: |
      Reset GPIO. Used by the controller to reset the sensor. Active low.

  gesture-release-timeout-ms:
    type: int
    default: 30
    description: |
        Timeout in milliseconds for gesture release.
```

## device/zephyr/dts/bindings/hynitron,cst816d.yaml
```yaml
# Copyright(c) 2025, Realtek Semiconductor Corporation. All rights reserved.
# SPDX-License-Identifier: Apache-2.0

description: Hynitron CST816D touchscreen sensor

compatible: "hynitron,cst816d"

include: i2c-device.yaml

properties:
  irq-gpios:
    type: phandle-array
    required: true
    description: |
      Interrupt GPIO. Used by the controller to signal touch data is
      available. Active low falling edge.

  rst-gpios:
    type: phandle-array
    required: true
    description: |
      Reset GPIO. Used by the controller to reset the sensor.

  gesture-release-timeout-ms:
    type: int
    default: 30
    description: |
      Timeout in milliseconds after which a touch gesture is considered released.
```

## device/zephyr/dts/bindings/hynitron,cst820.yaml
```yaml
# Copyright(c) 2025, Realtek Semiconductor Corporation. All rights reserved.
# SPDX-License-Identifier: Apache-2.0

description: Hynitron CST820 touchscreen sensor

compatible: "hynitron,cst820"

include: i2c-device.yaml

properties:
  irq-gpios:
    type: phandle-array
    required: true
    description: |
      Interrupt GPIO. Used by the controller to signal touch data is
      available. Active low falling edge.

  rst-gpios:
    type: phandle-array
    required: true
    description: |
      Reset GPIO. Used by the controller to reset the sensor.

  pwr-gpios:
    type: phandle-array
    required: false
    description: |
      Optional power enable GPIO for the sensor supply rail. Asserted before
      the reset sequence so the sensor is powered when its registers are
      first accessed. Omit on boards where the rail is always on.

  pwr-en-gpios:
    type: phandle-array
    required: false
    description: |
      Optional main supply enable GPIO, asserted before pwr-gpios. On boards
      where the sensor sits behind a board-level rail (shared with other
      peripherals) this is that rail's enable. Omit when the rail is always on
      or enabled elsewhere.
  

  gesture-release-timeout-ms:
    type: int
    default: 30
    description: |
      Timeout in milliseconds after which a touch gesture is considered released.
```

## device/zephyr/dts/bindings/realtek,gpio-keys.yaml
```yaml
# Copyright (c) 2018, Linaro Limited
# SPDX-License-Identifier: Apache-2.0

description: |
  Zephyr Input GPIO KEYS parent node

  This defines a group of buttons that can generate input events. Each button
  is defined in a child node of the gpio-keys node and defines a specific key
  code.

  For example:

  / {
      gpio_keys: gpio_keys{
          compatible = "realtek,gpio-keys";
          debounce-interval-ms = <30>;
          key1: key1{
              gpios = <KEY1_GPIO_PIN (GPIO_ACTIVE_HIGH | GPIO_PULL_UP)>;
              label = "key1";
              key,id = <100>;
              status = "okay";
          };
      };
  };

compatible: "realtek,gpio-keys"

include: base.yaml

properties:
  debounce-interval-ms:
    type: int
    default: 30
    description: |
       Debouncing interval time in milliseconds.
       If not specified defaults to 30.

child-binding:
  description: GPIO KEYS child node
  properties:
    gpios:
      type: phandle-array
      required: true

    label:
      type: string
      description: Descriptive name of the key

    key,id:
      type: int
      description: Key code to emit.
      required: true
```

## device/zephyr/dts/bindings/realtek,rtl87x3g-display-lcd.yaml
```yaml
# Copyright (c) 2021 Nordic Semiconductor ASA
# SPDX-License-Identifier: Apache-2.0

description: 
    Bindings for the Realtek RTL87x3G LCD display driver

compatible: "realtek,rtl87x3g-display-lcd"

include: display-controller.yaml
```
