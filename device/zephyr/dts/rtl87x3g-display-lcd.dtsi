/*
 * Copyright(c) 2024, Realtek Semiconductor Corporation.
 *
 * SPDX-License-Identifier: Apache-2.0
 */

#include <zephyr/dt-bindings/gpio/realtek-rtl87x3g-gpio.h>
#include <dt-bindings/pinctrl/rtl87x3g-pinctrl.h>



/ {

	display_lcd: display@8000000 {
		compatible = "realtek,rtl87x3g-display-lcd";
		reg = <0x08000000 0x80000>;  // fade by howie
		width = <480>;
		height = <272>;
	};

};

